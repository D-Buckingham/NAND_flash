## src/NAND_FLASH_DHARA/Kconfig
```kconfig
menu "NAND Flash Dhara Configuration"

config HEALTH_MONITORING
    bool "Enable Health Monitoring"
    default y
    help
      Enable this option to compile the health monitoring part of the code.


config DHARA_METADATA_BUFFER
    bool "Enable metadata buffer, buffering 16 y 132 bytes in a table"
    default n
    help
      Enable this option to minimize the actual reads from the dhara mapping


config DHARA_METADATA_BUFFER_SIZE
    int "Enable metadata buffer, buffering 16 y 132 bytes in a table"
    default 8
    help
      Enable this option to minimize the actual reads from the dhara mapping

endmenu
```
